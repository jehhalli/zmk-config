## boards/shields/jlk/Kconfig.defconfig
```kconfig
if SHIELD_JLK

config ZMK_KEYBOARD_NAME
  default "jlk"

# config ZMK_SLEEP
#   default y
# 
# config ZMK_IDLE_SLEEP_TIMEOUT
#   default 300000
# 
# config ZMK_EXT_POWER
#   default n

config BT
  default n

config ZMK_BLE
  default n

endif
```

## boards/shields/jlkfs/Kconfig.defconfig
```kconfig
if SHIELD_JLKFS_RIGHT

config ZMK_KEYBOARD_NAME
  default "jlkfs"

config ZMK_SPLIT_ROLE_CENTRAL
  default y

endif

if SHIELD_JLKFS_LEFT || SHIELD_JLKFS_RIGHT

config ZMK_SPLIT
  default y

config ZMK_SLEEP
  default y

config ZMK_IDLE_SLEEP_TIMEOUT
  default 300000

config ZMK_EXT_POWER
  default n

endif
```

## boards/shields/jlkfs/Kconfig.shield
```kconfig
config SHIELD_JLKFS_LEFT
  def_bool $(shields_list_contains,jlkfs_left)

config SHIELD_JLKFS_RIGHT
  def_bool $(shields_list_contains,jlkfs_right)
```

## boards/shields/jlks/Kconfig.defconfig
```kconfig
if SHIELD_JLKS_LEFT

config ZMK_KEYBOARD_NAME
  default "jlks"

config ZMK_SPLIT_ROLE_CENTRAL
  default y

endif

if SHIELD_JLKS_LEFT || SHIELD_JLKS_RIGHT

config ZMK_SPLIT
  default y

config ZMK_KSCAN_DIRECT_POLLING
  default y

config ZMK_SLEEP
  default y

config ZMK_IDLE_SLEEP_TIMEOUT
  default 300000

config ZMK_EXT_POWER
  default n

endif
```

## boards/shields/jlks/Kconfig.shield
```kconfig
config SHIELD_JLKS_LEFT
  def_bool $(shields_list_contains,jlks_left)

config SHIELD_JLKS_RIGHT
  def_bool $(shields_list_contains,jlks_right)
```

## boards/shields/jlks_rm/Kconfig.defconfig
```kconfig
if SHIELD_JLKS_RM_RIGHT

config ZMK_KEYBOARD_NAME
  default "jlks"

config ZMK_SPLIT_ROLE_CENTRAL
  default y

endif

if SHIELD_JLKS_RM_LEFT || SHIELD_JLKS_RM_RIGHT

config ZMK_SPLIT
  default y

config ZMK_SLEEP
  default y

config ZMK_IDLE_SLEEP_TIMEOUT
  default 300000

config ZMK_EXT_POWER
  default n

endif
```

## boards/shields/jlks_rm/Kconfig.shield
```kconfig
config SHIELD_JLKS_RM_LEFT
  def_bool $(shields_list_contains,jlks_rm_left)

config SHIELD_JLKS_RM_RIGHT
  def_bool $(shields_list_contains,jlks_rm_right)
```

## boards/shields/kfs/Kconfig.defconfig
```kconfig
if SHIELD_KFS

config ZMK_KEYBOARD_NAME
  default "kfs"

config ZMK_SLEEP
  default y

config ZMK_IDLE_SLEEP_TIMEOUT
  default 300000

config ZMK_EXT_POWER
  default n

endif
```
